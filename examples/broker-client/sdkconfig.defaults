## examples/broker-client/sdkconfig.defaults
```kconfig
CONFIG_ESPTOOLPY_FLASHSIZE_4MB=y
CONFIG_ESP_MAIN_TASK_STACK_SIZE=4096
CONFIG_MQTT_PROTOCOL_311=y
CONFIG_MQTT_PROTOCOL_5=n
CONFIG_MQTT_TRANSPORT_SSL=y
CONFIG_MQTT_REPORT_DELETED_MESSAGES=y
CONFIG_MBEDTLS_HAVE_TIME_DATE=y
CONFIG_ESP_PHY_CALIBRATION_AND_DATA_STORAGE=n
```

## examples/custom_outbox/sdkconfig.defaults
```kconfig
CONFIG_MQTT_CUSTOM_OUTBOX=y
CONFIG_MQTT_REPORT_DELETED_MESSAGES=y
CONFIG_MBEDTLS_HAVE_TIME_DATE=y
CONFIG_COMPILER_CXX_EXCEPTIONS=y
CONFIG_COMPILER_OPTIMIZATION_SIZE=y
```

## tests/c3-smoke/sdkconfig.defaults
```kconfig
CONFIG_IDF_TARGET="esp32c3"
CONFIG_MQTT_PROTOCOL_311=y
CONFIG_MQTT_PROTOCOL_5=n
CONFIG_MQTT_TRANSPORT_SSL=y
CONFIG_MQTT_REPORT_DELETED_MESSAGES=y
CONFIG_MBEDTLS_HAVE_TIME_DATE=y
```

## tests/iram-overflow/sdkconfig.defaults
```kconfig
CONFIG_IDF_TARGET="esp32"
CONFIG_APP_BUILD_TYPE_RAM=y
CONFIG_APP_BUILD_TYPE_PURE_RAM_APP=y
CONFIG_FREERTOS_UNICORE=y
CONFIG_ESP32_IRAM_AS_8BIT_ACCESSIBLE_MEMORY=y
CONFIG_COMPILER_OPTIMIZATION_SIZE=y
CONFIG_VFS_SUPPORT_TERMIOS=n
CONFIG_LIBC_NEWLIB_NANO_FORMAT=y
CONFIG_ESP_SYSTEM_PANIC_PRINT_HALT=y
CONFIG_ESP_DEBUG_STUBS_ENABLE=n
CONFIG_ESP_ERR_TO_NAME_LOOKUP=n
CONFIG_ESP_TASK_WDT_EN=n
```

## tests/linux-broker/sdkconfig.defaults
```kconfig
CONFIG_IDF_TARGET="linux"
CONFIG_MQTT_PROTOCOL_311=y
CONFIG_MQTT_PROTOCOL_5=n
CONFIG_MQTT_TRANSPORT_SSL=n
CONFIG_MQTT_REPORT_DELETED_MESSAGES=y
CONFIG_MBEDTLS_HAVE_TIME_DATE=y
CONFIG_EMQTT_PLAINTEXT_LAB=y
```
